## conf/machine/phyboard-pollux-imx8mp-3-custom.conf
```bitbake
require conf/machine/phyboard-pollux-imx8mp-3.conf

KERNEL_DEVICETREE:append = " freescale/imx8mp-phyboard-pollux-custom.dtbo"
```

## conf/machine/phyboard-rigel-am67xx-1-mcu-spi1.conf
```bitbake
#@TYPE: Machine
#@NAME: phyboard-rigel-am67xx-1
#@DESCRIPTION: PHYTEC phyBOARD Rigel AM67x, HS-FS
#@ARTICLENUMBERS: PCM-080.A0

require conf/machine/phyboard-rigel-am67xx-1.conf

KERNEL_OVERLAYS_PHYTEC:append = " \
	ti/k3-am6754-phyboard-rigel-x37-mcu-spi1.dtbo \
"
```
