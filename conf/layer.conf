## conf/layer.conf
```bitbake
# We have a conf and classes directory, add to BBPATH
BBPATH .= ":${LAYERDIR}"

# We have recipes-* directories, add to BBFILES
BBFILES += "${LAYERDIR}/recipes-*/*/*.bb \
            ${LAYERDIR}/recipes-*/*/*.bbappend \
            ${LAYERDIR}/recipes-core/systemd/*.bbappend"


BBFILE_COLLECTIONS += "meta-can-disable"
BBFILE_PATTERN_meta-can-disable = "^${LAYERDIR}/"
BBFILE_PRIORITY_meta-can-disable = "15"

LAYERDEPENDS_meta-can-disable = "core"
LAYERSERIES_COMPAT_meta-can-disable = "dunfell"
```

## conf/machine/phyboard-electra-am64xx-2-custom.conf
```bitbake
require conf/machine/phyboard-electra-am64xx-2.conf

WKS_FILE = "sdimage-2part-custom.wks"
```

## conf/machine/phyboard-lyra-am62xx-3-custom-k3r5.conf
```bitbake
#@TYPE: Machine
#@NAME: phyboard-lyra-am62xx-3-custom-k3r5
#@DESCRIPTION: Custom MACHINE that inherits from PHYTEC's phyCORE-AM62x Linux development kit (RAM auto-detection), eMMC, with display/graphics
#@ARTICLENUMBERS: KPB-07124-002.A0, PCM-071-5432DE11I.A0, PCM-071-3231BX11I.A0

require conf/machine/phyboard-lyra-am62xx-3-k3r5.conf
```

## conf/machine/phyboard-lyra-am62xx-3-custom.conf
```bitbake
#@TYPE: Machine
#@NAME: phyboard-lyra-am62xx-3-custom
#@DESCRIPTION: Custom MACHINE that inherits from PHYTEC's phyCORE-AM62x Linux development kit (RAM auto-detection), eMMC, with display/graphics
#@ARTICLENUMBERS: KPB-07124-002.A0, PCM-071-5432DE11I.A0, PCM-071-3231BX11I.A0

require conf/machine/phyboard-lyra-am62xx-3.conf
```

## conf/machine/phyboard-zeta-imx7d-custom.conf
```bitbake
#@TYPE: Machine
#@NAME: phyboard-zeta-imx7d-custom
#@DESCRIPTION: Custom MACHINE that inherits phyboard-zeta-imd7d-1 (phyCORE-i.MX7 Dual, 1GB RAM, eMMC)
#@ARTICLENUMBERS: PB-01910-004.A0

require conf/machine/phyboard-zeta-imx7d-1.conf
```
